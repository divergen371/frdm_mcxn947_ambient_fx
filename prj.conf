## CMakeLists.txt
```
cmake_minimum_required(VERSION 3.22.0)

include(${SdkRootDirPath}/cmake/extension/mcux.cmake)

project(frdm_mcxn947_ambient_fx LANGUAGES C CXX ASM)

include(${SdkRootDirPath}/CMakeLists.txt)

mcux_add_source(
    BASE_PATH ${CMAKE_CURRENT_LIST_DIR}
    SOURCES
        src/main.c
        src/board_audio.c
        src/audio_synth.c
        src/ambient_reverb.c
)

mcux_add_include(
    BASE_PATH ${CMAKE_CURRENT_LIST_DIR}
    INCLUDES
        src
)

mcux_remove_armgcc_configuration(
    CC "-fno-builtin"
    LD "-fno-builtin"
)

mcux_remove_armgcc_configuration(
    TARGETS debug
    CC "-O0"
)

mcux_add_armgcc_configuration(
    TARGETS debug
    CC "-Og -g3"
)

mcux_remove_armgcc_configuration(
    TARGETS release
    CC "-Os -mapcs"
    LD "-mapcs"
)

mcux_add_armgcc_configuration(
    TARGETS release
    CC "-O3 -flto=auto"
    LD "-O3 -flto=auto"
)

mcux_convert_binary(BINARY ${APPLICATION_BINARY_DIR}/${MCUX_SDK_PROJECT_NAME}.bin)
mcux_convert_binary(BINARY ${APPLICATION_BINARY_DIR}/${MCUX_SDK_PROJECT_NAME}.hex)
```

## prj.conf
```kconfig
CONFIG_MCUX_COMPONENT_driver.sai=y
CONFIG_MCUX_COMPONENT_driver.gpio=y
CONFIG_MCUX_COMPONENT_driver.port=y

CONFIG_MCUX_PRJSEG_module.board.pinmux_customize_folder=y
CONFIG_MCUX_PRJSEG_project.hw_app_customize_folder=y
```

## src/main.c
```c
/**
 * @file main.c
 * @brief FRDM-MCXN947 + PCM5102A 48 kHz フルレート アンビエント／シューゲイザー DSP エフェクタ
 */

#include <stdbool.h>
#include <stdint.h>
#include "fsl_common.h"
#include "fsl_debug_console.h"
#include "fsl_sai.h"

#include "ambient_reverb.h"
#include "audio_synth.h"
#include "board_audio.h"

/* DSP 負荷の実測区間 (ms)。UART 出力自体が負荷になるため、区間ごとに集計をリセットする */
#define DSP_PROFILE_REPORT_MS 5000U

static bool g_ch_right = false;
static int32_t g_cur_l = 0;
static int32_t g_cur_r = 0;

/*
 * DSP 1 フレーム (L/R ペア) あたりの実行サイクル集計。
 * ISR 側は加算のみ行い、UART 出力はメインループ側で行う。
 */
static volatile uint32_t g_prof_sum   = 0U;
static volatile uint32_t g_prof_max   = 0U;
static volatile uint32_t g_prof_count = 0U;

static void dsp_profile_accumulate(uint32_t cycles)
{
    g_prof_sum += cycles;
    if (cycles > g_prof_max)
    {
        g_prof_max = cycles;
    }
    g_prof_count++;
}

/* プリセット／原音切替直後の過渡を混ぜないため、区間を明示的に区切る */
static void dsp_profile_reset(void)
{
    DisableIRQ(AUDIO_SAI_IRQ);
    g_prof_sum   = 0U;
    g_prof_max   = 0U;
    g_prof_count = 0U;
    EnableIRQ(AUDIO_SAI_IRQ);
}

/*
 * 集計値を取り出して表示し、次の区間へ向けてリセットする。
 * 1 サンプル周期は SystemCoreClock / Fs なので、その比がそのまま DSP 占有率になる。
 */
static void dsp_profile_report(ambient_preset_t preset)
{
    DisableIRQ(AUDIO_SAI_IRQ);
    uint32_t sum   = g_prof_sum;
    uint32_t max   = g_prof_max;
    uint32_t count = g_prof_count;
    g_prof_sum     = 0U;
    g_prof_max     = 0U;
    g_prof_count   = 0U;
    EnableIRQ(AUDIO_SAI_IRQ);

    if (count == 0U)
    {
        return;
    }

    uint32_t budget = SystemCoreClock / AUDIO_SAMPLE_RATE_HZ;
    uint32_t avg    = sum / count;
    uint32_t pct100 = (budget != 0U) ? ((avg * 10000U) / budget) : 0U;

    /*
     * Debug console lite は [length] 指定子 (%lu 等) を解釈しないため、
     * 32 bit 環境である前提で %u / %d のみを使う。
     */
    PRINTF("[DSP] avg %u cyc/frame (%u.%02u%% of %u) max %u over %u frames | %s\r\n",
           (unsigned int)avg,
           (unsigned int)(pct100 / 100U),
           (unsigned int)(pct100 % 100U),
           (unsigned int)budget,
           (unsigned int)max,
           (unsigned int)count,
           ambient_reverb_get_preset_name(preset));
}

static void update_led_for_preset(ambient_preset_t preset)
{
    switch (preset)
    {
        case AMBIENT_PRESET_REVERSE_GATE:       board_audio_set_rgb(true,  false, false); break; /* Red */
        case AMBIENT_PRESET_EARLY_REFLECTIONS:  board_audio_set_rgb(false, true,  false); break; /* Green */
        case AMBIENT_PRESET_CHORUS_3PHASE:      board_audio_set_rgb(false, false, true ); break; /* Blue */
        case AMBIENT_PRESET_PAN_CROSS_RAMP:     board_audio_set_rgb(true,  true,  false); break; /* Yellow */
        case AMBIENT_PRESET_PAN_STARDUST:       board_audio_set_rgb(false, true,  true ); break; /* Cyan */
        case AMBIENT_PRESET_PAN_PSYCHE_CHOP:    board_audio_set_rgb(true,  false, true ); break; /* Magenta */
        case AMBIENT_PRESET_SHIMMER_HALL:       board_audio_set_rgb(false, true,  true ); break; /* Cyan */
        case AMBIENT_PRESET_SHOEGAZE_CATHEDRAL: board_audio_set_rgb(true,  false, true ); break; /* Magenta */
        case AMBIENT_PRESET_TENSION_BLOOM:      board_audio_set_rgb(true,  true,  false); break; /* Gold / Yellow */
        case AMBIENT_PRESET_RUIN_CATHEDRAL:     board_audio_set_rgb(true,  false, false); break; /* Crimson / Red */
        case AMBIENT_PRESET_BYPASS:             board_audio_set_rgb(true,  true,  true ); break; /* White */
        case AMBIENT_PRESET_OFF:
        default:                                board_audio_set_rgb(false, false, false); break; /* Off */
    }
}

static void sai_fill_fifo(void)
{
    uint32_t watermark = (uint32_t)FSL_FEATURE_SAI_FIFO_COUNTn(AUDIO_SAI) / 2U;

    for (uint32_t i = 0U; i < watermark; i++)
    {
        if (!g_ch_right)
        {
            /* 原音生成と 24-bit DSP をまとめて 1 フレーム分の実コストとして計測する */
            uint32_t t0   = MSDK_GetCpuCycleCount();
            int32_t in_q23 = (int32_t)audio_synth_next_sample() << 8;
            ambient_reverb_process_stereo_q23(in_q23, &g_cur_l, &g_cur_r);
            dsp_profile_accumulate(MSDK_GetCpuCycleCount() - t0);

            /* 32-bit I2S スロットの上位 24-bit へ左詰め送信 (PCM5102A / PCM1808 64fs 共通) */
            SAI_WriteData(AUDIO_SAI, AUDIO_SAI_CHANNEL, (uint32_t)g_cur_l << 8);
        }
        else
        {
            SAI_WriteData(AUDIO_SAI, AUDIO_SAI_CHANNEL, (uint32_t)g_cur_r << 8);
        }
        g_ch_right = !g_ch_right;
    }
}

void AUDIO_SAI_IRQ_HANDLER(void)
{
    uint32_t flags = SAI_TxGetStatusFlag(AUDIO_SAI);

    if ((flags & (uint32_t)kSAI_FIFOErrorFlag) != 0U)
    {
        SAI_TxClearStatusFlags(AUDIO_SAI, kSAI_FIFOErrorFlag);
    }

    if ((flags & (uint32_t)kSAI_FIFOWarningFlag) != 0U)
    {
        sai_fill_fifo();
    }

    SDK_ISR_EXIT_BARRIER;
}

static void init_sai_i2s_master(void)
{
    sai_transceiver_t sai_cfg;
    sai_master_clock_t mclk_cfg;

    SAI_Init(AUDIO_SAI);

    SAI_GetClassicI2SConfig(&sai_cfg, AUDIO_BIT_WIDTH, kSAI_Stereo, 1U << AUDIO_SAI_CHANNEL);
    sai_cfg.masterSlave = kSAI_Master;
    sai_cfg.syncMode    = kSAI_ModeAsync;
    sai_cfg.fifo.fifoWatermark = (uint8_t)(FSL_FEATURE_SAI_FIFO_COUNTn(AUDIO_SAI) / 2U);

    SAI_TxSetConfig(AUDIO_SAI, &sai_cfg);
    SAI_TxSetBitClockRate(AUDIO_SAI, AUDIO_MCLK_HZ, AUDIO_SAMPLE_RATE_HZ, AUDIO_BIT_WIDTH, AUDIO_DATA_CHANNELS);

    mclk_cfg.mclkOutputEnable = true;
    mclk_cfg.mclkHz           = AUDIO_MCLK_HZ;
    mclk_cfg.mclkSourceClkHz  = AUDIO_MCLK_HZ;
    SAI_SetMasterClockConfig(AUDIO_SAI, &mclk_cfg);

    /* 初回 FIFO を充填してから割り込み・送信を有効化 */
    g_ch_right = false;
    sai_fill_fifo();
    sai_fill_fifo();

    NVIC_SetPriority(AUDIO_SAI_IRQ, 2U);
    EnableIRQ(AUDIO_SAI_IRQ);
    SAI_TxEnableInterrupts(AUDIO_SAI, kSAI_FIFOWarningInterruptEnable | kSAI_FIFOErrorInterruptEnable);
    SAI_TxEnable(AUDIO_SAI, true);
}

int main(void)
{
    ambient_preset_t preset = AMBIENT_PRESET_REVERSE_GATE;
    audio_synth_src_t src   = SYNTH_SRC_SHOEGAZE_GLIDE;
    bool sw2_prev = false;
    bool sw3_prev = false;

    board_audio_init_hardware();
    ambient_reverb_init();
    audio_synth_set_src(src);
    ambient_reverb_set_preset(preset);
    update_led_for_preset(preset);

    /* DWT サイクルカウンタを有効化 (DSP 負荷の実測用) */
    MSDK_EnableCpuCycleCounter();

    PRINTF("\r\n=== FRDM-MCXN947 48kHz / 24-bit Full-Rate Ambient/Shoegaze DSP ===\r\n");
    PRINTF("Core: %u Hz | SAI1 MCLK: %u Hz | Fs: %u Hz 24-bit (64fs, 0 ppm)\r\n",
           (unsigned int)SystemCoreClock, (unsigned int)AUDIO_MCLK_HZ, (unsigned int)AUDIO_SAMPLE_RATE_HZ);
    PRINTF("SW2: Preset | SW3: Source\r\n");
    PRINTF("Preset: %s\r\n", ambient_reverb_get_preset_name(preset));
    PRINTF("Source: %s\r\n", audio_synth_get_name(src));

    init_sai_i2s_master();

    uint32_t prof_start      = MSDK_GetCpuCycleCount();
    const uint32_t prof_span = (SystemCoreClock / 1000U) * DSP_PROFILE_REPORT_MS;

    for (;;)
    {
        bool sw2_now = board_audio_sw2_pressed();
        bool sw3_now = board_audio_sw3_pressed();

        if (sw2_now && !sw2_prev)
        {
            SDK_DelayAtLeastUs(20000U, SystemCoreClock);
            if (board_audio_sw2_pressed())
            {
                preset = (ambient_preset_t)((preset + 1U) % AMBIENT_PRESET_COUNT);
                DisableIRQ(AUDIO_SAI_IRQ);
                ambient_reverb_set_preset(preset);
                EnableIRQ(AUDIO_SAI_IRQ);
                update_led_for_preset(preset);
                PRINTF("Preset: %s\r\n", ambient_reverb_get_preset_name(preset));
                dsp_profile_reset();
                prof_start = MSDK_GetCpuCycleCount();
            }
        }

        if (sw3_now && !sw3_prev)
        {
            SDK_DelayAtLeastUs(20000U, SystemCoreClock);
            if (board_audio_sw3_pressed())
            {
                src = (audio_synth_src_t)((src + 1U) % SYNTH_SRC_COUNT);
                DisableIRQ(AUDIO_SAI_IRQ);
                audio_synth_set_src(src);
                EnableIRQ(AUDIO_SAI_IRQ);
                PRINTF("Source: %s\r\n", audio_synth_get_name(src));
                dsp_profile_reset();
                prof_start = MSDK_GetCpuCycleCount();
            }
        }

        if ((uint32_t)(MSDK_GetCpuCycleCount() - prof_start) >= prof_span)
        {
            dsp_profile_report(preset);
            prof_start = MSDK_GetCpuCycleCount();
        }

        sw2_prev = sw2_now;
        sw3_prev = sw3_now;
        SDK_DelayAtLeastUs(10000U, SystemCoreClock);
    }
}
```

## src/ambient_reverb.h
```c
/**
 * @file ambient_reverb.h
 * @brief FRDM-MCXN947 48 kHz フルレート SPX90 風 Reverse Gate / Early Reflections
 *        + Dimension Chorus + 高域/低域独立波形ハーモニック・パンニング
 *        + 4x4 Hadamard FDN + シマー (Fuzz 抜き)
 */

#ifndef AMBIENT_REVERB_H
#define AMBIENT_REVERB_H

#include <stdint.h>

typedef enum
{
    PAN_WAVE_SINE = 0,       /* 滑らかなサイン波 */
    PAN_WAVE_TRIANGLE,       /* 等速直線パン (三角波) */
    PAN_WAVE_RAMP_UP,        /* ノコギリ波 (左 -> 右へ流れて戻る) */
    PAN_WAVE_RAMP_DOWN,      /* 逆ノコギリ波 (右 -> 左へ流れて戻る) */
    PAN_WAVE_SOFT_SQUARE,    /* 丸めた矩形波 (跳ね / スライサー風) */
    PAN_WAVE_SMOOTH_RANDOM,  /* 滑らかランダム (xorshift + 補間) */
    PAN_WAVE_COUNT
} ambient_pan_wave_t;

typedef struct
{
    uint8_t decay;        /* 0..255: FDN フィードバック量 */
    uint8_t shimmer;      /* 0..255: +1 オクターブ・シマー帰還量 */
    uint8_t tap_level;    /* 0..255: 32 タップ FIR (Reverse Gate / ER) レベル */
    uint8_t chorus;       /* 0..255: Dimension Chorus レベル */
    uint8_t mix;          /* 0..255: Dry / Wet バランス */
    uint8_t tap_mode;     /* 0: OFF, 1: Reverse Gate, 2: Early Reflections */
    uint8_t pan_depth;    /* 0..255: ハーモニック・パンニング深さ (0=OFF) */
    uint8_t pan_rate;     /* 0..255: パンニング速度 (約 0.20..3.40 Hz) */
    uint8_t pan_hi_wave;  /* ambient_pan_wave_t: 高域パン波形 */
    uint8_t pan_lo_wave;  /* ambient_pan_wave_t: 低域パン波形 */
    uint8_t tension;      /* 0..255: 入力反応テンション・ブルーム量 */
    uint8_t tension_mode; /* 0: OFF, 1: Choir Bloom, 2: Ruin Cathedral (Floating Ghost Choir) */
} ambient_params_t;

typedef enum
{
    AMBIENT_PRESET_REVERSE_GATE = 0,
    AMBIENT_PRESET_EARLY_REFLECTIONS,
    AMBIENT_PRESET_CHORUS_3PHASE,
    AMBIENT_PRESET_PAN_CROSS_RAMP,
    AMBIENT_PRESET_PAN_STARDUST,
    AMBIENT_PRESET_PAN_PSYCHE_CHOP,
    AMBIENT_PRESET_SHIMMER_HALL,
    AMBIENT_PRESET_SHOEGAZE_CATHEDRAL,
    AMBIENT_PRESET_TENSION_BLOOM,
    AMBIENT_PRESET_RUIN_CATHEDRAL,
    AMBIENT_PRESET_BYPASS,
    AMBIENT_PRESET_OFF,
    AMBIENT_PRESET_COUNT
} ambient_preset_t;

void ambient_reverb_init(void);
void ambient_reverb_set_preset(ambient_preset_t preset);
void ambient_reverb_set_params(const ambient_params_t *params);
const char *ambient_reverb_get_preset_name(ambient_preset_t preset);
const char *ambient_reverb_get_pan_wave_name(ambient_pan_wave_t wave);
void ambient_reverb_process_stereo_q23(int32_t x, int32_t *out_l, int32_t *out_r);
void ambient_reverb_process_stereo(int16_t x, int16_t *out_l, int16_t *out_r);

#endif /* AMBIENT_REVERB_H */
```

## src/audio_synth.c
```c
/**
 * @file audio_synth.c
 * @brief 48 kHz / 16-bit 固定小数点 DDS テスト音源 (グライドコード / アルペジオ / ノコギリ波)
 */

#include "audio_synth.h"
#include <stdbool.h>

/* 32-bit 位相増分 = round(f * 2^32 / 48000) */
#define PHASE_INC_F3 15624260UL
#define PHASE_INC_G3 17537541UL
#define PHASE_INC_A3 19685267UL
#define PHASE_INC_C4 23409808UL
#define PHASE_INC_D4 26276415UL
#define PHASE_INC_E4 29494312UL
#define PHASE_INC_F4 31248413UL
#define PHASE_INC_A4 39370534UL
#define PHASE_INC_B4 44191472UL
#define PHASE_INC_C5 46819616UL
#define PHASE_INC_E5 58988625UL
#define PHASE_INC_G5 70150165UL
#define PHASE_INC_B5 88382944UL

#define ARP_STEP_SAMPLES 12000UL   /* 0.25 秒 / 音 */
#define GAZE_BAR_SAMPLES 120000UL  /* 2.50 秒ごとにコードチェンジ */
#define GAZE_GLIDE_INC   76056UL   /* 約 0.85 Hz アーム揺らし (減衰中に約 2 往復) */

/* 256 点サイン波テーブル (振幅 2048 ≒ -24 dBFS) */
static const int16_t g_sine_lut[256] = {
        0,    50,   100,   151,   201,   251,   301,   350,
      400,   449,   498,   546,   595,   642,   690,   737,
      784,   830,   876,   921,   965,  1009,  1053,  1096,
     1138,  1179,  1220,  1260,  1299,  1338,  1375,  1412,
     1448,  1483,  1517,  1551,  1583,  1615,  1645,  1674,
     1703,  1730,  1757,  1782,  1806,  1829,  1851,  1872,
     1892,  1911,  1928,  1945,  1960,  1974,  1987,  1998,
     2009,  2018,  2026,  2033,  2038,  2042,  2046,  2047,
     2048,  2047,  2046,  2042,  2038,  2033,  2026,  2018,
     2009,  1998,  1987,  1974,  1960,  1945,  1928,  1911,
     1892,  1872,  1851,  1829,  1806,  1782,  1757,  1730,
     1703,  1674,  1645,  1615,  1583,  1551,  1517,  1483,
     1448,  1412,  1375,  1338,  1299,  1260,  1220,  1179,
     1138,  1096,  1053,  1009,   965,   921,   876,   830,
      784,   737,   690,   642,   595,   546,   498,   449,
      400,   350,   301,   251,   201,   151,   100,    50,
        0,   -50,  -100,  -151,  -201,  -251,  -301,  -350,
     -400,  -449,  -498,  -546,  -595,  -642,  -690,  -737,
     -784,  -830,  -876,  -921,  -965, -1009, -1053, -1096,
    -1138, -1179, -1220, -1260, -1299, -1338, -1375, -1412,
    -1448, -1483, -1517, -1551, -1583, -1615, -1645, -1674,
    -1703, -1730, -1757, -1782, -1806, -1829, -1851, -1872,
    -1892, -1911, -1928, -1945, -1960, -1974, -1987, -1998,
    -2009, -2018, -2026, -2033, -2038, -2042, -2046, -2047,
    -2048, -2047, -2046, -2042, -2038, -2033, -2026, -2018,
    -2009, -1998, -1987, -1974, -1960, -1945, -1928, -1911,
    -1892, -1872, -1851, -1829, -1806, -1782, -1757, -1730,
    -1703, -1674, -1645, -1615, -1583, -1551, -1517, -1483,
    -1448, -1412, -1375, -1338, -1299, -1260, -1220, -1179,
    -1138, -1096, -1053, -1009,  -965,  -921,  -876,  -830,
     -784,  -737,  -690,  -642,  -595,  -546,  -498,  -449,
     -400,  -350,  -301,  -251,  -201,  -151,  -100,   -50
};

static volatile audio_synth_src_t g_src = SYNTH_SRC_SHOEGAZE_GLIDE;
static uint32_t g_ph[4] = { 0UL, 0UL, 0UL, 0UL };
static uint32_t g_v_freq[4] = { PHASE_INC_F3, PHASE_INC_C4, PHASE_INC_E4, PHASE_INC_A4 };
static uint16_t g_v_env[4] = { 0U, 0U, 0U, 0U };
static uint8_t g_v_atk[4] = { 0U, 0U, 0U, 0U };
static uint32_t g_glide_ph = 0UL;
static uint32_t g_cnt = 0UL;
static uint16_t g_env = 0U;
static uint8_t g_attack = 1U;
static uint8_t g_step = 0U;

void audio_synth_set_src(audio_synth_src_t src)
{
    if (src >= SYNTH_SRC_COUNT)
    {
        src = SYNTH_SRC_SHOEGAZE_GLIDE;
    }
    g_src = src;
    for (uint8_t i = 0U; i < 4U; i++)
    {
        g_ph[i] = 0UL;
        g_v_env[i] = 0U;
        g_v_atk[i] = 0U;
    }
    g_v_freq[0] = PHASE_INC_F3;
    g_v_freq[1] = PHASE_INC_C4;
    g_v_freq[2] = PHASE_INC_E4;
    g_v_freq[3] = PHASE_INC_A4;
    g_glide_ph = 0UL;
    g_cnt = 0UL;
    g_env = 0U;
    g_attack = 1U;
    g_step = 0U;
}

audio_synth_src_t audio_synth_get_src(void)
{
    return g_src;
}

const char *audio_synth_get_name(audio_synth_src_t src)
{
    switch (src)
    {
        case SYNTH_SRC_SHOEGAZE_GLIDE: return "Shoegaze Glide Chord (Fmaj7 - G6 - Asus4 - G9sus4)";
        case SYNTH_SRC_PLUCK_ARP:      return "Bell Pluck Arpeggio (C5-E5-G5-B5)";
        case SYNTH_SRC_SAW_220:        return "Sawtooth 220 Hz";
        default:                       return "Unknown";
    }
}

int16_t audio_synth_next_sample(void)
{
    switch (g_src)
    {
        case SYNTH_SRC_SHOEGAZE_GLIDE:
        {
            static const uint32_t gaze_chords[4][4] = {
                { PHASE_INC_F3, PHASE_INC_C4, PHASE_INC_E4, PHASE_INC_A4 }, /* Fmaj7 */
                { PHASE_INC_G3, PHASE_INC_D4, PHASE_INC_E4, PHASE_INC_B4 }, /* G6 */
                { PHASE_INC_A3, PHASE_INC_D4, PHASE_INC_E4, PHASE_INC_A4 }, /* Asus4 */
                { PHASE_INC_G3, PHASE_INC_C4, PHASE_INC_F4, PHASE_INC_A4 }, /* G9sus4 (sus9) */
            };
            /* 低音弦から高音弦へ 18 ms 刻み (計 54 ms) のダウンストローク・ストラム */
            static const uint32_t strum_at[4] = { 0UL, 864UL, 1728UL, 2592UL };
            /* 低音弦ほど長く、高音弦ほど早めに自然減衰 (64 サンプルごとの Q15 減衰係数) */
            static const uint32_t decay_q15[4] = { 32732UL, 32724UL, 32718UL, 32710UL };

            /* 滑らかなトレモロアーム曲線 (0..1023 -> 最大約 -83 cents のジャズマスター風グライド) */
            uint16_t gp = (uint16_t)(g_glide_ph >> 21);
            uint16_t tri = (gp < 1024U) ? gp : (uint16_t)(2047U - gp);
            /* 押し込みを強調する軽い S 字カーブ: (3*t^2 - 2*t^3) の簡易近似として t*(2048-t)>>10 と併用 */
            uint32_t bend = ((uint32_t)tri * (uint32_t)tri) >> 10; /* 0..1022: 戻りは安定、押し込みが深い */
            const uint32_t *chord = gaze_chords[g_step & 3U];
            bool do_decay = ((g_cnt & 0x3FUL) == 0UL);
            int32_t mix = 0;

            for (uint8_t i = 0U; i < 4U; i++)
            {
                /* 各弦のストラム時刻でコード周波数を切替え、滑らかなピックアタックを開始 */
                if (g_cnt == strum_at[i])
                {
                    g_v_freq[i] = chord[i];
                    g_v_atk[i] = 1U;
                }

                uint32_t f = g_v_freq[i];
                f -= (((f >> 15) * bend) * 3UL) >> 1;

                uint32_t ph = g_ph[i];
                int32_t fund = (int32_t)g_sine_lut[(uint8_t)(ph >> 24)];
                int32_t h2 = (int32_t)g_sine_lut[(uint8_t)(ph >> 23)];
                int32_t h3 = (int32_t)g_sine_lut[(uint8_t)((ph * 3UL) >> 24)];
                g_ph[i] = ph + f;

                /* ピッキング直後は倍音が明るく鳴り、減衰とともに基音中心の丸い音へ変化 (env^2) */
                int32_t env = (int32_t)g_v_env[i];
                int32_t h_env = (env * env) >> 15;
                int32_t voice = ((fund * env) >> 15)
                              + (((h2 * 3 + h3) * h_env) >> 18);
                mix += voice;

                if (g_v_atk[i] != 0U)
                {
                    /* 約 6.2 ms の滑らかなピックアタック (クリックゼロ) */
                    uint32_t next_env = (uint32_t)g_v_env[i] + 110UL;
                    if (next_env >= 32767UL)
                    {
                        g_v_env[i] = 32767U;
                        g_v_atk[i] = 0U;
                    }
                    else
                    {
                        g_v_env[i] = (uint16_t)next_env;
                    }
                }
                else if (do_decay && (g_v_env[i] > 0U))
                {
                    g_v_env[i] = (uint16_t)(((uint32_t)g_v_env[i] * decay_q15[i]) >> 15);
                }
            }

            g_glide_ph += GAZE_GLIDE_INC;
            g_cnt++;
            if (g_cnt >= GAZE_BAR_SAMPLES)
            {
                g_cnt = 0UL;
                g_step = (uint8_t)((g_step + 1U) & 3U);
                g_glide_ph = 0UL; /* ストラム直後に原音ピッチからグッとアームダウンが始まる */
            }
            return (int16_t)(mix >> 2);
        }

        case SYNTH_SRC_PLUCK_ARP:
        {
            static const uint32_t arp_inc[4] = {
                PHASE_INC_C5, PHASE_INC_E5, PHASE_INC_G5, PHASE_INC_B5
            };
            int32_t s = 0;

            if (g_step < 4U)
            {
                s = (int32_t)g_sine_lut[(uint8_t)(g_ph[0] >> 24)]
                  + ((int32_t)g_sine_lut[(uint8_t)(g_ph[0] >> 23)] >> 2);
                g_ph[0] += arp_inc[g_step];
                s = (s * (int32_t)g_env) >> 15;
            }

            g_cnt++;
            if (g_attack != 0U)
            {
                /* 約 3.8 ms のアタックランプでベル音の輪郭を保ちつつクリックを防止 */
                uint32_t next_env = (uint32_t)g_env + 180UL;
                if (next_env >= 32767UL)
                {
                    g_env = 32767U;
                    g_attack = 0U;
                }
                else
                {
                    g_env = (uint16_t)next_env;
                }
            }
            else if ((g_cnt & 0x07UL) == 0UL)
            {
                g_env = (uint16_t)(((uint32_t)g_env * 32600UL) >> 15);
            }
            if (g_cnt >= ARP_STEP_SAMPLES)
            {
                g_cnt = 0UL;
                g_step++;
                if (g_step >= 8U)
                {
                    g_step = 0U;
                }
                g_env = 0U;
                g_attack = (g_step < 4U) ? 1U : 0U;
                g_ph[0] = 0UL;
            }
            return (int16_t)s;
        }

        case SYNTH_SRC_SAW_220:
        default:
        {
            int16_t saw = (int16_t)((uint16_t)(g_ph[0] >> 20)) - 2048;
            saw = (int16_t)((saw * 3) >> 2);
            g_ph[0] += PHASE_INC_A3;
            return saw;
        }
    }
}
```

## src/audio_synth.h
```c
/**
 * @file audio_synth.h
 * @brief 48 kHz / 16-bit 固定小数点 DDS テスト音源
 */

#ifndef AUDIO_SYNTH_H
#define AUDIO_SYNTH_H

#include <stdint.h>

typedef enum
{
    SYNTH_SRC_SHOEGAZE_GLIDE = 0,
    SYNTH_SRC_PLUCK_ARP,
    SYNTH_SRC_SAW_220,
    SYNTH_SRC_COUNT
} audio_synth_src_t;

void audio_synth_set_src(audio_synth_src_t src);
audio_synth_src_t audio_synth_get_src(void);
const char *audio_synth_get_name(audio_synth_src_t src);
int16_t audio_synth_next_sample(void);

#endif /* AUDIO_SYNTH_H */
```

## src/board_audio.c
```c
/**
 * @file board_audio.c
 * @brief FRDM-MCXN947 ハードウェア初期化 (150 MHz Core + 12.288 MHz Audio PLL1 + SAI1 + LED/SW)
 */

#include "board_audio.h"
#include "board.h"
#include "clock_config.h"
#include "fsl_clock.h"
#include "fsl_gpio.h"
#include "fsl_port.h"

static void init_pins(void)
{
    CLOCK_EnableClock(kCLOCK_Port0);
    CLOCK_EnableClock(kCLOCK_Port1);
    CLOCK_EnableClock(kCLOCK_Port3);
    CLOCK_EnableClock(kCLOCK_Gpio0);
    CLOCK_EnableClock(kCLOCK_Gpio1);

    /* デバッグ UART (LP_FLEXCOMM4: P1_8 RX, P1_9 TX) */
    const port_pin_config_t uart_cfg = {
        kPORT_PullDisable,
        kPORT_LowPullResistor,
        kPORT_FastSlewRate,
        kPORT_PassiveFilterDisable,
        kPORT_OpenDrainDisable,
        kPORT_LowDriveStrength,
        kPORT_MuxAlt2,
        kPORT_InputBufferEnable,
        kPORT_InputNormal,
        kPORT_UnlockRegister,
    };
    PORT_SetPinConfig(PORT1, 8U, &uart_cfg);
    PORT_SetPinConfig(PORT1, 9U, &uart_cfg);

    /* SAI1 ピン (ALT10): P3_16 BCLK, P3_17 FS, P3_20 TXD0, P1_21 MCLK */
    const port_pin_config_t sai_cfg = {
        kPORT_PullDisable,
        kPORT_LowPullResistor,
        kPORT_FastSlewRate,
        kPORT_PassiveFilterDisable,
        kPORT_OpenDrainDisable,
        kPORT_HighDriveStrength,
        kPORT_MuxAlt10,
        kPORT_InputBufferEnable,
        kPORT_InputNormal,
        kPORT_UnlockRegister,
    };
    PORT_SetPinConfig(PORT3, 16U, &sai_cfg); /* J1[1]  SAI1_TX_BCLK */
    PORT_SetPinConfig(PORT3, 17U, &sai_cfg); /* J1[11] SAI1_TX_FS   */
    PORT_SetPinConfig(PORT3, 20U, &sai_cfg); /* J1[5]  SAI1_TXD0    */
    PORT_SetPinConfig(PORT1, 21U, &sai_cfg); /* J1[7]  SAI1_MCLK    */

    /* RGB LED: P0_10 (Red), P0_27 (Green), P1_2 (Blue) - Active Low */
    const port_pin_config_t led_cfg = {
        kPORT_PullDisable,
        kPORT_LowPullResistor,
        kPORT_FastSlewRate,
        kPORT_PassiveFilterDisable,
        kPORT_OpenDrainDisable,
        kPORT_LowDriveStrength,
        kPORT_MuxAlt0,
        kPORT_InputBufferDisable,
        kPORT_InputNormal,
        kPORT_UnlockRegister,
    };
    PORT_SetPinConfig(PORT0, BOARD_LED_RED_GPIO_PIN, &led_cfg);
    PORT_SetPinConfig(PORT0, BOARD_LED_GREEN_GPIO_PIN, &led_cfg);
    PORT_SetPinConfig(PORT1, BOARD_LED_BLUE_GPIO_PIN, &led_cfg);

    const gpio_pin_config_t led_gpio = { kGPIO_DigitalOutput, 1U };
    GPIO_PinInit(BOARD_LED_RED_GPIO, BOARD_LED_RED_GPIO_PIN, &led_gpio);
    GPIO_PinInit(BOARD_LED_GREEN_GPIO, BOARD_LED_GREEN_GPIO_PIN, &led_gpio);
    GPIO_PinInit(BOARD_LED_BLUE_GPIO, BOARD_LED_BLUE_GPIO_PIN, &led_gpio);

    /* SW2 (P0_23), SW3 (P0_6) - Active Low, 内部プルアップ有効 */
    const port_pin_config_t sw_cfg = {
        kPORT_PullUp,
        kPORT_LowPullResistor,
        kPORT_FastSlewRate,
        kPORT_PassiveFilterEnable,
        kPORT_OpenDrainDisable,
        kPORT_LowDriveStrength,
        kPORT_MuxAlt0,
        kPORT_InputBufferEnable,
        kPORT_InputNormal,
        kPORT_UnlockRegister,
    };
    PORT_SetPinConfig(PORT0, BOARD_SW2_GPIO_PIN, &sw_cfg);
    PORT_SetPinConfig(PORT0, BOARD_SW3_GPIO_PIN, &sw_cfg);

    const gpio_pin_config_t sw_gpio = { kGPIO_DigitalInput, 0U };
    GPIO_PinInit(BOARD_SW2_GPIO, BOARD_SW2_GPIO_PIN, &sw_gpio);
    GPIO_PinInit(BOARD_SW3_GPIO, BOARD_SW3_GPIO_PIN, &sw_gpio);
}

void board_audio_init_hardware(void)
{
    init_pins();

    /* Core Clock = 150 MHz (PLL0) */
    BOARD_InitBootClocks();

    /* Debug Console UART (115200 bps) */
    CLOCK_AttachClk(BOARD_DEBUG_UART_CLK_ATTACH);
    CLOCK_SetClkDiv(kCLOCK_DivFlexcom4Clk, 1U);
    BOARD_InitDebugConsole();

    /*
     * Audio PLL1 (外部 24 MHz 水晶 -> 122.88 MHz -> /10 = 12.288 MHz, 理論誤差 0 ppm)
     * 参照: mcuxsdk/examples/_boards/frdmmcxn947/driver_examples/pdm/pdm_sai_interrupt/cm33_core0/hardware_init.c
     */
    CLOCK_SetupExtClocking(24000000U);
    const pll_setup_t pll1Setup = {
        .pllctrl = SCG_SPLLCTRL_SOURCE(0U) | SCG_SPLLCTRL_SELI(15U) | SCG_SPLLCTRL_SELP(31U),
        .pllndiv = SCG_SPLLNDIV_NDIV(25U),
        .pllpdiv = SCG_SPLLPDIV_PDIV(2U),
        .pllmdiv = SCG_SPLLMDIV_MDIV(512U),
        .pllRate = 122880000U,
    };
    CLOCK_SetPLL1Freq(&pll1Setup);

    /* PLL1_CLK0 = 122.88 MHz / 10 = 12.288 MHz -> SAI1 */
    CLOCK_SetClkDiv(kCLOCK_DivPLL1Clk0, 10U);
    CLOCK_AttachClk(kPLL1_CLK0_to_SAI1);
    CLOCK_SetClkDiv(kCLOCK_DivSai1Clk, 1U);
}

void board_audio_set_rgb(bool r, bool g, bool b)
{
    /* Active Low */
    GPIO_PinWrite(BOARD_LED_RED_GPIO, BOARD_LED_RED_GPIO_PIN, r ? 0U : 1U);
    GPIO_PinWrite(BOARD_LED_GREEN_GPIO, BOARD_LED_GREEN_GPIO_PIN, g ? 0U : 1U);
    GPIO_PinWrite(BOARD_LED_BLUE_GPIO, BOARD_LED_BLUE_GPIO_PIN, b ? 0U : 1U);
}

bool board_audio_sw2_pressed(void)
{
    return (GPIO_PinRead(BOARD_SW2_GPIO, BOARD_SW2_GPIO_PIN) == 0U);
}

bool board_audio_sw3_pressed(void)
{
    return (GPIO_PinRead(BOARD_SW3_GPIO, BOARD_SW3_GPIO_PIN) == 0U);
}
```

## src/board_audio.h
```c
/**
 * @file board_audio.h
 * @brief FRDM-MCXN947 SAI1 (I2S Master) / PLL1 (12.288 MHz) / SW2・SW3 / RGB LED 定義
 *
 * ピン配置 (UM12018 Table 17 / Table 19):
 *   J1[1]  P3_16 (ALT10) -> SAI1_TX_BCLK -> PCM5102A BCK  (3.072 MHz, 64fs)
 *   J1[11] P3_17 (ALT10) -> SAI1_TX_FS   -> PCM5102A LCK  (48.000 kHz)
 *   J1[5]  P3_20 (ALT10) -> SAI1_TXD0    -> PCM5102A DIN
 *   J1[7]  P1_21 (ALT10) -> SAI1_MCLK    -> (任意: 12.288 MHz)
 *
 * オンボード UI (board.h):
 *   SW2: P0_23 (Active Low) -> プリセット切替
 *   SW3: P0_6  (Active Low) -> 原音切替
 *   LED: Red P0_10, Green P0_27, Blue P1_2 (Active Low)
 */

#ifndef BOARD_AUDIO_H
#define BOARD_AUDIO_H

#include <stdbool.h>
#include <stdint.h>
#include "fsl_sai.h"

#define AUDIO_SAI                 SAI1
#define AUDIO_SAI_CHANNEL         0U
#define AUDIO_SAI_IRQ             SAI1_IRQn
#define AUDIO_SAI_IRQ_HANDLER     SAI1_IRQHandler

#define AUDIO_SAMPLE_RATE_HZ      48000U
#define AUDIO_BIT_WIDTH           kSAI_WordWidth32bits /* 32-bit スロット / 上位 24-bit 有効 (64fs, PCM5102A/PCM1808 互換) */
#define AUDIO_DATA_CHANNELS       2U
#define AUDIO_MCLK_HZ             12288000U

/**
 * @brief クロック (PLL0 150 MHz, PLL1 122.88 MHz -> 12.288 MHz), ピン, UART, LED, SW を初期化する
 */
void board_audio_init_hardware(void);

/**
 * @brief RGB LED の点灯色を設定する (1: 点灯, 0: 消灯)
 */
void board_audio_set_rgb(bool r, bool g, bool b);

/**
 * @brief オンボード SW2 (プリセット切替) の押下状態を取得する
 */
bool board_audio_sw2_pressed(void);

/**
 * @brief オンボード SW3 (原音切替) の押下状態を取得する
 */
bool board_audio_sw3_pressed(void);

#endif /* BOARD_AUDIO_H */
```
